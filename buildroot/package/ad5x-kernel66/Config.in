## buildroot/package/ad5x-kernel66/Config.in
```kconfig
config BR2_PACKAGE_AD5X_KERNEL66
	bool "ad5x-kernel66"
	help
	  Our 6.6 kernel (Ingenic's X2600 SDK kernel with the AD5X device
	  tree and patches, kernel-ingenic66/) and chainload.ko, which starts
	  it from the printer's stock 5.10 kernel at boot when chosen with
	  "ad5x-kernel own" (S00ad5x-kernel). Installed in
	  /usr/lib/ad5x/kernel66; the boot slots keep the stock kernel.

	  Needs a checkout of the Ingenic SDK (see kernel-ingenic66/README.md)
	  and the 5.10 header tree for chainload.ko
	  (kernel-ingenic66/chainload/setup.sh).

if BR2_PACKAGE_AD5X_KERNEL66

config BR2_PACKAGE_AD5X_KERNEL66_SDK
	string "Ingenic 6.6 SDK checkout"
	default "$(HOME)/workspace/ingenic-sdk-6.6"

config BR2_PACKAGE_AD5X_KERNEL66_KDIR510
	string "linux-5.10.186 tree for chainload.ko"
	default "$(HOME)/workspace/chainload-build/linux-5.10.186"

endif
```

## buildroot/package/ad5x-lvgl/Config.in
```kconfig
config BR2_PACKAGE_AD5X_LVGL
	bool
	help
	  LVGL v9 sources (pinned release tarball), for this tree's
	  LVGL programs (ad5x-recovery-ui). Nothing is installed: each
	  program compiles LVGL with its own lv_conf.h from
	  $(AD5X_LVGL_DIR).

	  https://lvgl.io
```

## buildroot/package/ad5x-recovery-ui/Config.in
```kconfig
config BR2_PACKAGE_AD5X_RECOVERY_UI
	bool "ad5x-recovery-ui"
	depends on BR2_USE_MMU # fork
	depends on BR2_TOOLCHAIN_HAS_THREADS
	select BR2_PACKAGE_AD5X_LVGL
	help
	  Touch screen UI of the AD5X recovery OS (LVGL v9 on the
	  800x480 framebuffer, evdev touch): boot the main OS, install
	  .swu updates with SWUpdate's progress, back up / restore the
	  eMMC to and from a USB stick, restore stock, network/SSH info,
	  logs. Runs the recovery OS's ad5x-* tools (see
	  docs/recovery-os.md); started by S80ad5x-recovery-ui.
	  Source in the repo's recovery-ui/.

comment "ad5x-recovery-ui needs a toolchain w/ threads"
	depends on BR2_USE_MMU
	depends on !BR2_TOOLCHAIN_HAS_THREADS
```

## buildroot/package/ad5x-recovery/Config.in
```kconfig
config BR2_PACKAGE_AD5X_RECOVERY
	bool "ad5x-recovery"
	depends on BR2_INIT_BUSYBOX
	depends on BR2_PACKAGE_SWUPDATE
	select BR2_PACKAGE_DROPBEAR
	# unsquashfs: vendor files from the saved stock root (ad5x-vendor)
	select BR2_PACKAGE_SQUASHFS
	select BR2_PACKAGE_SQUASHFS_LZO
	help
	  AD5X recovery/update OS (slot A): the printer's own drivers and board
	  heartbeat, network, SSH, SWUpdate (signed .swu into slot B),
	  backup/restore tools and the USB rescue hook.
	  See docs/recovery-os.md.
```

## buildroot/package/ad5x-system/Config.in
```kconfig
config BR2_PACKAGE_AD5X_SYSTEM
	bool "ad5x-system"
	depends on BR2_INIT_BUSYBOX
	depends on BR2_PACKAGE_PYTHON3
	select BR2_PACKAGE_PYTHON_SERIAL
	# unsquashfs: vendor files from the saved stock root (ad5x-vendor)
	select BR2_PACKAGE_SQUASHFS
	select BR2_PACKAGE_SQUASHFS_LZO
	help
	  AD5X start-up: data partition, the stock kernel's driver modules,
	  Wi-Fi, the eboard bootloader handshake (tools/boot_eboard.py) and
	  the Klipper service.
```

## buildroot/package/fluidd/Config.in
```kconfig
config BR2_PACKAGE_FLUIDD
	bool "fluidd"
	depends on BR2_USE_MMU # nginx
	select BR2_PACKAGE_NGINX
	select BR2_PACKAGE_NGINX_HTTP
	select BR2_PACKAGE_NGINX_HTTP_PROXY_MODULE
	select BR2_PACKAGE_NGINX_HTTP_MAP_MODULE
	select BR2_PACKAGE_NGINX_HTTP_GZIP_STATIC_MODULE
	help
	  Fluidd, the web front end for Klipper/Moonraker: the prebuilt
	  release, in /usr/share/fluidd, served by nginx on port 80
	  (/etc/nginx/nginx.conf, S63nginx) with Moonraker proxied.

	  https://github.com/fluidd-core/fluidd
```

## buildroot/package/helixscreen/Config.in
```kconfig
config BR2_PACKAGE_HELIXSCREEN
	bool "helixscreen"
	depends on BR2_INSTALL_LIBSTDCPP
	depends on BR2_TOOLCHAIN_HAS_THREADS
	depends on BR2_TOOLCHAIN_GCC_AT_LEAST_8 # C++17, std::filesystem
	select BR2_PACKAGE_OPENSSL
	select BR2_PACKAGE_ZLIB
	help
	  HelixScreen, an LVGL touch screen UI for Klipper/Moonraker,
	  built from source for the panel's framebuffer (fbdev) and
	  evdev touch. In /usr/lib/helixscreen; started by
	  S70helixscreen when /data/ad5x/helixscreen.enable exists.

	  https://github.com/prestonbrown/helixscreen
```

## buildroot/package/klipper/Config.in
```kconfig
config BR2_PACKAGE_KLIPPER
	bool "klipper"
	depends on BR2_PACKAGE_PYTHON3
	select BR2_PACKAGE_PYTHON_CFFI
	select BR2_PACKAGE_PYTHON_GREENLET
	select BR2_PACKAGE_PYTHON_JINJA2
	select BR2_PACKAGE_PYTHON_MARKUPSAFE
	# SHAPER_CALIBRATE (setup wizard vibration step)
	select BR2_PACKAGE_PYTHON_NUMPY
	select BR2_PACKAGE_PYTHON_SERIAL
	help
	  Mainline Klipper host software (klippy), with this project's
	  extras (IFS, weighing board, analog runout sensor, setup wizard)
	  and the AD5X printer.cfg / ifs.cfg / setup.cfg as defaults.

	  https://www.klipper3d.org/
```

## buildroot/package/moonraker/Config.in
```kconfig
config BR2_PACKAGE_MOONRAKER
	bool "moonraker"
	depends on BR2_PACKAGE_PYTHON3
	select BR2_PACKAGE_PYTHON3_PYEXPAT # xml (dbus-fast introspection)
	select BR2_PACKAGE_PYTHON3_SQLITE # database
	select BR2_PACKAGE_PYTHON_TORNADO
	select BR2_PACKAGE_PYTHON_PILLOW
	select BR2_PACKAGE_PYTHON_DISTRO
	select BR2_PACKAGE_PYTHON_JINJA2
	select BR2_PACKAGE_PYTHON_SERIAL
	select BR2_PACKAGE_PYTHON_DBUS_FAST
	select BR2_PACKAGE_PYTHON_INOTIFY_SIMPLE
	select BR2_PACKAGE_PYTHON_LIBNACL
	select BR2_PACKAGE_PYTHON_STREAMING_FORM_DATA
	help
	  Moonraker, the API server for Klipper (web front ends,
	  slicer uploads), with the AD5X moonraker.conf as default.

	  https://github.com/Arksine/moonraker
```

## buildroot/package/python-inotify-simple/Config.in
```kconfig
config BR2_PACKAGE_PYTHON_INOTIFY_SIMPLE
	bool "python-inotify-simple"
	help
	  A simple Python wrapper around inotify (used by Moonraker's
	  file manager).

	  https://github.com/chrisjbillington/inotify_simple
```

## buildroot/package/python-libnacl/Config.in
```kconfig
config BR2_PACKAGE_PYTHON_LIBNACL
	bool "python-libnacl"
	select BR2_PACKAGE_LIBSODIUM
	help
	  ctypes bindings for libsodium (used by Moonraker's
	  authorization).

	  https://github.com/saltstack/libnacl
```

## buildroot/package/python-streaming-form-data/Config.in
```kconfig
config BR2_PACKAGE_PYTHON_STREAMING_FORM_DATA
	bool "python-streaming-form-data"
	select BR2_PACKAGE_PYTHON_AIOFILES # runtime
	help
	  Streaming parser for multipart/form-data (Moonraker file
	  uploads). smart_open (S3/GCS targets) is not included.

	  https://github.com/siddhantgoel/streaming-form-data
```
